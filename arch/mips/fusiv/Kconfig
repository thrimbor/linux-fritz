## arch/mips/fusiv/Kconfig
```kconfig
choice
	prompt "Fusiv Processor Type"
	depends on MACH_FUSIV
	default MACH_FUSIV_MIPS32

config MACH_FUSIV_MIPS1
	bool "Fusiv MIPS-1 based Lexra Core"
	select BOOT_ELF32
	select IRQ_CPU
	select HW_HAS_PCI
	select DMA_NONCOHERENT
	select CPU_SUPPORTS_32BIT_KERNEL
	select SYS_SUPPORTS_32BIT_KERNEL
	select SYS_SUPPORTS_BIG_ENDIAN
	select SYS_HAS_CPU_R3000

config MACH_FUSIV_MIPS32
	bool "Fusiv MIPS32 Core"
	select BOOT_ELF32
	select DMA_NONCOHERENT
	select IRQ_CPU
	select HW_HAS_PCI
	select CPU_HAS_LLSC
	select SYS_HAS_CPU_MIPS32_R2
	select SYS_HAS_CPU_MIPS32_R1
	select SYS_SUPPORTS_32BIT_KERNEL
	select SYS_SUPPORTS_BIG_ENDIAN

endchoice

choice
	prompt "Fusiv Platform Type"
	depends on MACH_FUSIV
        default FUSIV_VX180

config FUSIV_VX200
	bool "Fusiv vox 200 / vox 150"
	depends on MACH_FUSIV_MIPS1

config FUSIV_VX160
	bool "Fusiv vox 160"
	depends on MACH_FUSIV_MIPS1

config FUSIV_AT300
	bool "Fusiv AT 100/200/300"
	depends on MACH_FUSIV_MIPS1

config FUSIV_VX180
	bool "Fusiv vox 180"
	depends on MACH_FUSIV_MIPS32

endchoice
```

## drivers/atm/Kconfig.ifx
```kconfig
config IFX_ATM
	tristate "IFX ATM driver"
	depends on (DANUBE || AMAZON_SE || AR9 || VR9 || AR10) && ATM && IFX_PPA_DATAPATH != y
	default n
	---help---
	Use this exclusively with PTM mode or Acceleration Package

config IFX_ATM_TASKLET
	bool "Support Tasklet"
	depends on IFX_ATM
	default y
	---help---
	Use tasklet handle incoming packet. Impact on ATM RX traffic performance.

config IFX_ATM_RETX
	bool "Support ReTX"
	depends on IFX_ATM && (DANUBE || AR9 || AR10)
	default n
	---help---
	Support Retransmission.

config IFX_PTM
	tristate "IFX PTM driver"
	depends on (DANUBE || AMAZON_SE || AR9 || VR9) && IFX_PPA_DATAPATH != y
	default n
	---help---
	Use this exclusively with ATM mode or Acceleration Package

choice
	prompt "RX Packet Handling Mechanism"
	depends on IFX_PTM
	default IFX_PTM_RX_NAPI

config IFX_PTM_RX_NAPI
	bool "NAPI"

config IFX_PTM_RX_TASKLET
	bool "Tasklet"
	depends on DANUBE || AMAZON_SE || AR9

config IFX_PTM_RX_INTERRUPT
	bool "Interrupt"
	depends on DANUBE || AMAZON_SE || AR9

endchoice

config IFX_PTM_TEST_PROC
	bool "IFX PTM Driver Test Proc"
	depends on IFX_PTM
	default n

config IFX_ADTRAN_PTM
	tristate "IFX PTM driver for Adtran project"
	depends on VR9 && IFX_PPA_DATAPATH != y
	default n
	---help---
	Use this exclusively with ATM mode or Acceleration Package
```

## drivers/isdn/Kconfig
```kconfig
#
# ISDN device configuration
#

menuconfig ISDN
	bool "ISDN support"
	depends on NET
	depends on !S390
	---help---
	  ISDN ("Integrated Services Digital Networks", called RNIS in France)
	  is a special type of fully digital telephone service; it's mostly
	  used to connect to your Internet service provider (with SLIP or
	  PPP).  The main advantage is that the speed is higher than ordinary
	  modem/telephone connections, and that you can have voice
	  conversations while downloading stuff.  It only works if your
	  computer is equipped with an ISDN card and both you and your service
	  provider purchased an ISDN line from the phone company.  For
	  details, read <http://www.alumni.caltech.edu/~dank/isdn/> on the WWW.

	  Select this option if you want your kernel to support ISDN.

if ISDN

menuconfig ISDN_I4L
	tristate "Old ISDN4Linux (deprecated)"
	---help---
	  This driver allows you to use an ISDN adapter for networking
	  connections and as dialin/out device.  The isdn-tty's have a built
	  in AT-compatible modem emulator.  Network devices support autodial,
	  channel-bundling, callback and caller-authentication without having
	  a daemon running.  A reduced T.70 protocol is supported with tty's
	  suitable for German BTX.  On D-Channel, the protocols EDSS1
	  (Euro-ISDN) and 1TR6 (German style) are supported.  See
	  <file:Documentation/isdn/README> for more information.

	  ISDN support in the linux kernel is moving towards a new API,
	  called CAPI (Common ISDN Application Programming Interface).
	  Therefore the old ISDN4Linux layer will eventually become obsolete.
	  It is still available, though, for use with adapters that are not
	  supported by the new CAPI subsystem yet.

source "drivers/isdn/mISDN/Kconfig"

source "drivers/isdn/i4l/Kconfig"

menuconfig ISDN_CAPI
	tristate "CAPI 2.0 subsystem"
	help
	  This provides the CAPI (Common ISDN Application Programming
	  Interface, a standard making it easy for programs to access ISDN
	  hardware, see <http://www.capi.org/>.  This is needed for AVM's set
	  of active ISDN controllers like B1, T1, M1.

if ISDN_CAPI

config CAPI_OSLIB
	tristate "split CAPI2.0 oslib"
	depends on ISDN
	help
        split oslib for fbox isdn drivers

config CAPI_OSLIB_DEBUG
    bool "capi oslib debug version"
    depends on CAPI_OSLIB
	help
        debug version of oslib 

config CAPI_CODEC
    tristate "capi driver codec support"
    depends on ISDN

config CAPI_CODEC_SPEEX
    bool "capi driver codec SPEEX"
    depends on CAPI_CODEC

config CAPI_CODEC_ILBC
    bool "capi driver codec ILBC"
    depends on CAPI_CODEC

config CAPI_CODEC_G729
    bool "capi driver codec G729"
    depends on CAPI_CODEC

config CAPI_CODEC_G711
    bool "capi driver codec G711"
    depends on CAPI_CODEC

config CAPI_CODEC_G726
    bool "capi driver codec G726"
    depends on CAPI_CODEC

config CAPI_CODEC_G722
    bool "capi driver codec G722"
    depends on CAPI_CODEC

config CAPI_CODEC_VAD
    bool "capi driver codec VAD"
    depends on CAPI_CODEC

config CAPI_CODEC_CNG
    bool "capi driver codec CNG (comfort noise generator)"
    depends on CAPI_CODEC

config CAPI_CODEC_FAX
    bool "capi driver codec FAX (T30/T38)"
    depends on CAPI_CODEC

config AVM_DECT
	tristate "AVM DECT Stack"

config AVM_DECT_DEBUG
    bool "AVM DECT debug version"
    depends on AVM_DECT

source "drivers/isdn/capi/Kconfig"

source "drivers/isdn/hardware/Kconfig"

endif # ISDN_CAPI

source "drivers/isdn/gigaset/Kconfig"

endif # ISDN
```

## drivers/isdn/hardware/avm/Kconfig
```kconfig
#
# ISDN AVM drivers
#

menuconfig CAPI_AVM
	bool "Active AVM cards"
	help
	  Enable support for AVM active ISDN cards.

if CAPI_AVM

config ISDN_DRV_AVMB1_B1ISA
	tristate "AVM B1 ISA support"
	depends on ISA
	help
	  Enable support for the ISA version of the AVM B1 card.

config ISDN_DRV_AVMB1_B1PCI
	tristate "AVM B1 PCI support"
	depends on PCI
	help
	  Enable support for the PCI version of the AVM B1 card.

config ISDN_DRV_AVMB1_B1PCIV4
	bool "AVM B1 PCI V4 support"
	depends on ISDN_DRV_AVMB1_B1PCI
	help
	  Enable support for the V4 version of AVM B1 PCI card.

config ISDN_DRV_AVMB1_T1ISA
	tristate "AVM T1/T1-B ISA support"
	depends on ISA
	help
	  Enable support for the AVM T1 T1B card.
	  Note: This is a PRI card and handle 30 B-channels.

config ISDN_DRV_AVMB1_B1PCMCIA
	tristate "AVM B1/M1/M2 PCMCIA support"
	help
	  Enable support for the PCMCIA version of the AVM B1 card.

config ISDN_DRV_AVMB1_AVM_CS
	tristate "AVM B1/M1/M2 PCMCIA cs module"
	depends on ISDN_DRV_AVMB1_B1PCMCIA && PCMCIA
	help
	  Enable the PCMCIA client driver for the AVM B1/M1/M2
	  PCMCIA cards.

config ISDN_DRV_AVMB1_T1PCI
	tristate "AVM T1/T1-B PCI support"
	depends on PCI
	help
	  Enable support for the AVM T1 T1B card.
	  Note: This is a PRI card and handle 30 B-channels.

config ISDN_DRV_AVMB1_C4
	tristate "AVM C4/C2 support"
	depends on PCI
	help
	  Enable support for the AVM C4/C2 PCI cards.
	  These cards handle 4/2 BRI ISDN lines (8/4 channels).

#
# UR8 ISDN-PCMLINK driver 
#

config ISDN_CAPI_ISDN_NT_PCMLINK
    tristate "AVM ISDN NT PCMLINK driver"
    depends on CAPI_AVM
    select ISDN_NT_PCMLINK_BLK
    select ISDN_NT_PCMLINK_E1
    select ISDN_NT_PCMLINK_STACK
    select ISDN_NT_PCMLINK_ISDN_AB

config ISDN_NT_PCMLINK_BLK
    tristate "AVM ISDN NT PCMLINK driver (hardware interfacing part)"
    depends on ISDN_CAPI_ISDN_NT_PCMLINK
    
config ISDN_NT_PCMLINK_E1
    tristate "AVM ISDN NT PCMLINK driver (layer 1 part)"
    depends on ISDN_CAPI_ISDN_NT_PCMLINK
    
config ISDN_NT_PCMLINK_STACK
    tristate "AVM ISDN NT PCMLINK driver (protocol stack)"
    depends on ISDN_CAPI_ISDN_NT_PCMLINK
    
config ISDN_NT_PCMLINK_ISDN_AB
    tristate "AVM ISDN NT PCMLINK driver (telephony part)"
    depends on ISDN_CAPI_ISDN_NT_PCMLINK
    
config ISDN_NT_PCMLINK_DEBUG
    bool "AVM ISDN NT PCMLINK driver debug"
    depends on ISDN_CAPI_ISDN_NT_PCMLINK
    
config ISDN_NT_PCMLINK_NO_BCHANNEL
    bool "AVM ISDN NT PCMLINK driver without B-Channels support"
    depends on ISDN_CAPI_ISDN_NT_PCMLINK
    
config ISDN_NT_PCMLINK_FAX
    bool "AVM ISDN NT PCMLINK driver with FAX support"
    depends on ISDN_CAPI_ISDN_NT_PCMLINK && !ISDN_NT_PCMLINK_NO_BCHANNEL
    
config ISDN_NT_PCMLINK_COMPRESS
    bool "AVM ISDN NT PCMLINK driver with Compression support"
    depends on ISDN_CAPI_ISDN_NT_PCMLINK && !ISDN_NT_PCMLINK_NO_BCHANNEL
    
config ISDN_NT_PCMLINK_MODEM
    bool "AVM ISDN NT PCMLINK driver with MODEM support"
    depends on ISDN_CAPI_ISDN_NT_PCMLINK && !ISDN_NT_PCMLINK_NO_BCHANNEL
    
config ISDN_NT_PCMLINK_DTMF
    bool "AVM ISDN NT PCMLINK driver with DTMF support"
    depends on ISDN_CAPI_ISDN_NT_PCMLINK && !ISDN_NT_PCMLINK_NO_BCHANNEL
    
config ISDN_NT_PCMLINK_VCTRLS
    bool "AVM ISDN NT PCMLINK driver virtual controller support"
    depends on ISDN_CAPI_ISDN_NT_PCMLINK
    
config ISDN_NT_PCMLINK_VCTRLS_NUMBER
    int "AVM ISDN NT PCMLINK driver, number of virtual controllers"
    depends on ISDN_CAPI_ISDN_NT_PCMLINK && ISDN_NT_PCMLINK_VCTRLS
    default 1

config ISDN_NT_PCMLINK_FRITZX
    bool "AVM ISDN NT PCMLINK driver with FRITZX controller support"
    depends on ISDN_CAPI_ISDN_NT_PCMLINK

endif # CAPI_AVM
```
